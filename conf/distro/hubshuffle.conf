## conf/distro/hubshuffle.conf
```bitbake
MAINTAINER = "hubshuffle <hubshuffled@gmail.com>"

# Base this distro on poky
require conf/distro/poky.conf

DISTRO = "hubshuffle"
DISTRO_NAME = "hubshuffle"
DISTRO_VERSION = "1.0"
DISTRO_CODENAME = "hubshuffle"
SDK_VENDOR = "-hushuffle-sdk"
SDK_VERSION := "${@'${DISTRO_VERSION}'.replace('snapshot-${DATE}', 'snapshot')}"

# The following replaces sysvinit with systemd along with the features necessary for Kodi
DISTRO_FEATURES += "systemd wifi opengl pam pulseaudio egl"
VIRTUAL-RUNTIME_init_manager = "systemd"
DISTRO_FEATURES_remove += " sysvinit bluetooth pcmcia wayland bluez5 pci ext2 irda x11 nfc ptest 3g"
VIRTUAL-RUNTIME_initscripts = "systemd-compat-units"
DISTRO_FEATURES_BACKFILL_CONSIDERED += "sysvinit"

# Set hostname
hostname_pn-base-files = "hubshuffle"

# Set locale
GLIBC_GENERATE_LOCALES = "en_GB.UTF-8 en_US.UTF-8"
IMAGE_LINGUAS = "en-gb en-us"

# Set default timezone
DEFAULT_TIMEZONE = "Europe/London"

# Whitelist commercial license. This is needed because of omxplayer and possible others.
LICENSE_FLAGS_WHITELIST = "commercial"
```

## conf/layer.conf
```bitbake
# We have a conf and classes directory, add to BBPATH
BBPATH .= ":${LAYERDIR}"

# We have recipes-* directories, add to BBFILES
BBFILES += "${LAYERDIR}/recipes-*/*/*.bb \
            ${LAYERDIR}/recipes-*/*/*.bbappend"

BBFILE_COLLECTIONS += "meta-hubshuffle-layer"
BBFILE_PATTERN_meta-hubshuffle-layer = "^${LAYERDIR}/"
BBFILE_PRIORITY_meta-hubshuffle-layer = "10"

LAYERDEPENDS_meta-hubshuffle-layer = "core"
LAYERDEPENDS_meta-hubshuffle-layer += "raspberrypi"
LAYERSERIES_COMPAT_meta-hubshuffle-layer = "thud warrior"
```

## conf/machine/raspberrypi3-custom.conf
```bitbake
#@TYPE: Machine
#@NAME: RaspberryPi 3 Development Board
#@DESCRIPTION: Custom machine configuration for the RaspberryPi 3

MACHINEOVERRIDES =. "raspberrypi3:${MACHINE}"

DEFAULTTUNE ?= "cortexa7thf-neon-vfpv4"
require conf/machine/include/tune-cortexa7.inc
require conf/machine/include/rpi-base.inc

MACHINE_EXTRA_RRECOMMENDS += "\
    linux-firmware-rpidistro-bcm43430 \
    linux-firmware-rpidistro-bcm43455 \
    bluez-firmware-rpidistro-bcm43430a1-hcd \
    bluez-firmware-rpidistro-bcm4345c0-hcd \
"
 
SDIMG_KERNELIMAGE ?= "kernel7.img"
SERIAL_CONSOLES ?= "115200;ttyS0"

# Raspberry Pi configuration parameters. For more details see rpi-config_git.bb and the 
# meta-raspberrypi user manual.
# Warning: Enabling UART conditions system clocks and affects h264 hardware decoding.
#ENABLE_UART = "1"
ENABLE_I2C = "1"
ENABLE_SPI_BUS = "1"
GPU_MEM = "320"
#DISABLE_SPLASH = "1"
#DISABLE_RPI_BOOT_LOGO = "1"
# See https://www.raspberrypi.org/documentation/configuration/config-txt/overclocking.md
ARM_FREQ = "1400"
GPU_FREQ = "450"
CORE_FREQ = "550"
SDRAM_FREQ = "550"
OVER_VOLTAGE = "1"
#KEY_DECODE_MPG2 = ""
#KEY_DECODE_WVC1 = ""
#DISABLE_OVERSCAN = ""
#DISABLE_SPLASH = "" 
#BOOT_DELAY = ""
#BOOT_DELAY_MS = ""
#HDMI_FORCE_HOTPLUG = ""
#HDMI_DRIVE = ""
#HDMI_GROUP = ""
#HDMI_MODE = ""
#CONFIG_HDMI_BOOST = ""
#SDTV_MODE = ""
#SDTV_ASPECT = ""
#DISPLAY_ROTATE = ""
#VIDEO_CAMERA = ""
#DISPMANX_OFFLINE = ""
#PITFT22 = ""
#PITFT28r = ""
#PITFT35r = ""
# MACHINE_FEATURES += "vc4graphics"
#VC4GRAPHICS = ""
#WAVESHARE_1024X600_C_2_1 = ""
#ENABLE_DWC2_PERIPHERAL = ""
#ENABLE_AT86RF = "" 
#ENABLE_CAN = ""

# Extra parameters to add to config.txt, don't forget "\n"
#RPI_EXTRA_CONFIG = ""

#KERNEL_MODULE_AUTOLOAD += "i2c-dev"

# Use u-boot instead of barebox
#RPI_USE_U_BOOT = "1"
#KERNEL_IMAGETYPE = "zImage"
#KERNEL_BOOTCMD = "bootz"
```
